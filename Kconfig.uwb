## Kconfig.uwb
```kconfig
menu "Sport Indoor Tracking"

rsource "samples/Kconfig"
rsource "drivers/Kconfig"
rsource "lib/Kconfig"

endmenu
```

## drivers/Kconfig
```kconfig
menu "Device Drivers"

rsource "sensor/Kconfig"

rsource "battery/Kconfig"

endmenu

menuconfig DW3000
	bool "DW3000"
	depends on SPI
	help
		Qorvo/Decawave DW3000 driver

module = DW3000
module-str = dw3000
source "subsys/logging/Kconfig.template.log_config"
```

## drivers/ble/Kconfig
```kconfig
config BLE
	bool "DW_BLE"
	help
	  Enable BLE Funcionality 
	  
config CTS
	bool "DW_CTS"
	help
	  Enable CTS Funcionality 
```

## drivers/dw3110/Kconfig
```kconfig
menuconfig DW3110
	bool "DW3110 Tranceiver"
	help
		Include DW3110 Tranceiver drivers in config
```

## drivers/dwm_led/Kconfig
```kconfig
config DW_LED
	bool "DW LED"
	help
	  Enable Simple way to toggle and set LEDs  
```

## drivers/sit_ble/Kconfig
```kconfig
config SIT_BLE
	bool "SIT BLE Interface"
	help
	  Enable BLE Funcionality 
	  
config SIT_CTS
	bool "SIT CTS Interface"
	help
	  Enable CTS Funcionality 
```

## drivers/sit_led/Kconfig
```kconfig
config SIT_LED
	bool "SIT LED Interface"
	help
	  Enable Simple way to toggle and set LEDs  
```

## lib/Kconfig
```kconfig
menu "SIT LIBs"

rsource "sit_ble/Kconfig"

rsource "sit_led/Kconfig"

rsource "sit/Kconfig"

rsource "sit_mesh/Kconfig"

rsource "sit_json/Kconfig"

rsource "cJSON/Kconfig"

endmenu

menuconfig SIT
	bool "Sport Indoor Tracking"
	help
		Include SIT LIB
```

## lib/cJSON/Kconfig
```kconfig
config cJSON
	bool "cJSON Lib"
	help
	  Enable cJSON Funcionality 
	  
config SIT_CTS
	bool "SIT CTS Interface"
	help
	  Enable CTS Funcionality 
```

## lib/sit/Kconfig
```kconfig
config SIT
	bool "SIT Interface"
	imply SIT_LED
	help
	  Enable All Sit Features for an Sports Indoor Tracking System (SIT) 

config SIT_DIAGNOSTIC
	bool "SIT Diagnostic Interface"
	help
	  Enable All Sit Diagnostic Features for distance measurements 
```

## lib/sit_ble/Kconfig
```kconfig
config SIT_BLE
	bool "SIT BLE Interface"
	imply BT
	imply FLASH
	help
	  Enable BLE Funcionality 
	  
config SIT_CTS
	bool "SIT CTS Interface"
	help
	  Enable CTS Funcionality 
```

## subsys/Kconfig
```kconfig
menu "Device Drivers"

rsource "sit_ble/Kconfig"

rsource "sit_led/Kconfig"

rsource "sit/Kconfig"

endmenu

menuconfig SIT
	bool "Sport Indoor Tracking"
	help
		Include SIT LIB
```

## subsys/sit/Kconfig
```kconfig
config SIT
	bool "SIT Interface"
	imply SIT_LED
	help
	  Enable All Sit Features for an Sports Indoor Tracking System (SIT) 
```

## subsys/sit_json/Kconfig
```kconfig
config SIT_JSON
	bool "SIT JSON Interface"
	imply GPIO
	help
	  Enable JSON Parser for SIT System  
```

## subsys/sit_led/Kconfig
```kconfig
config SIT_LED
	bool "SIT LED Interface"
	imply GPIO
	help
	  Enable Simple way to toggle and set LEDs  
```

## subsys/sit_mesh/Kconfig
```kconfig
config SIT_MESH
	bool "SIT Mesh Interface"
	imply SIT_LED
	imply BT
	imply BT_BROADCASTER
	imply BT_OBSERVER
	imply BT_MESH
	help
	  Enable BLE Mesh Funcionality 
```

## west.yml
```yaml
manifest:
  version: "0.13"
  remotes:
    - name: sit
      url-base: https://github.com/svhoy/uwb_zephyr_project
    - name: zephyrproject
      url-base: https://github.com/zephyrproject-rtos

  defaults:
    remote: sit

  projects:
    - name: zephyr
      repo-path: zephyr
      remote: zephyrproject
      revision: main
      import:
        name-whitelist:
          - cmsis
          - edtt
          - fatfs
          - hal_nordic
          - libmetal
          - littlefs
          - lvgl
          - mbedtls
          - mcumgr
          - mipi-sys-t
          - net-tools
          - nrf_hw_models
          - openthread
          - segger
          - tinycrypt

  self:
    path: sit
```
