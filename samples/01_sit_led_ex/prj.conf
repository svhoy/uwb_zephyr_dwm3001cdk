## CMakeLists.txt
```
cmake_minimum_required(VERSION 3.13.1)

set(BOARD_ROOT "${CMAKE_CURRENT_SOURCE_DIR}/../..")
set(DTS_ROOT "${CMAKE_CURRENT_SOURCE_DIR}/../..")
set(BOARD qorvo_dwm3001cdk)

find_package(Zephyr REQUIRED HINTS $ENV{ZEPHYR_BASE})
project(sit_led_example)


target_sources(app PRIVATE src/main.c)
```

## sample.yaml
```
sample:
  name: SIT LED Test example
```

## prj.conf
```kconfig
# Logging 
CONFIG_LOG=y
CONFIG_LOG_PRINTK=y

#Activate SIT_LED
CONFIG_SIT_LED=y
```

## src/main.c
```c
#include <stdio.h>

#include <zephyr/kernel.h>
#include <zephyr/logging/log.h>

#include "sit_led.h"

LOG_MODULE_REGISTER(main, LOG_LEVEL_INF);


void main(void)
{
	printk("Welcome to SIT LED Test Example\n");
	
	sit_led_init();

	while (1) {
		sit_toggle_led(1);
		k_sleep(K_MSEC(1000));
		sit_toggle_led(1);
		sit_toggle_led(0);
		k_sleep(K_MSEC(1000));
		sit_toggle_led(0);
		sit_toggle_led(2);
		k_sleep(K_MSEC(1000));
		sit_toggle_led(2);
		sit_toggle_led(3);
		k_sleep(K_MSEC(1000));
		sit_toggle_led(3);
		sit_toggle_led(2);
		k_sleep(K_MSEC(1000));
		sit_toggle_led(2);
		sit_toggle_led(0);
		k_sleep(K_MSEC(1000));
		sit_toggle_led(0);
	}
}
```
