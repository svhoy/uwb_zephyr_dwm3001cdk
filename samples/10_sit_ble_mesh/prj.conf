## CMakeLists.txt
```
cmake_minimum_required(VERSION 3.13.1)

set(BOARD_ROOT "${CMAKE_CURRENT_SOURCE_DIR}/../..")
set(DTS_ROOT "${CMAKE_CURRENT_SOURCE_DIR}/../..")
set(BOARD qorvo_dwm3001cdk)

find_package(Zephyr REQUIRED HINTS $ENV{ZEPHYR_BASE})
project(sit_ble_example)


target_sources(app PRIVATE src/main.c)
```

## sample.yaml
```
sample:
  name: SIT BLE example
```

## prj.conf
```kconfig
# Logging 
CONFIG_LOG=y
CONFIG_LOG_PRINTK=y

CONFIG_INIT_STACKS=y
CONFIG_MAIN_STACK_SIZE=512
CONFIG_SYSTEM_WORKQUEUE_STACK_SIZE=2048

CONFIG_FLASH=y
CONFIG_FLASH_MAP=y
CONFIG_NVS=y


# Activate SIT_BLE
CONFIG_SIT_MESH=y
CONFIG_HWINFO=n
CONFIG_SETTINGS=y

CONFIG_BT_DEVICE_NAME_DYNAMIC=y
CONFIG_BT_MESH_MODEL_GROUP_COUNT=2

CONFIG_BT_OBSERVER=y
CONFIG_BT_BROADCASTER=y
CONFIG_BT_CTLR_DUP_FILTER_LEN=0
CONFIG_BT_CTLR_LE_ENC=n
CONFIG_BT_CTLR_LE_PING=n
CONFIG_BT_DATA_LEN_UPDATE=n
CONFIG_BT_PHY_UPDATE=n
CONFIG_BT_CTLR_CHAN_SEL_2=n
CONFIG_BT_CTLR_MIN_USED_CHAN=n
CONFIG_BT_CTLR_ADV_EXT=n
CONFIG_BT_CTLR_PRIVACY=n

CONFIG_BT_PERIPHERAL=y

CONFIG_BT=y
CONFIG_BT_TINYCRYPT_ECC=y

CONFIG_BT_MESH=y
CONFIG_BT_MESH_RELAY=y
CONFIG_BT_MESH_RELAY_ENABLED=n
CONFIG_BT_MESH_BEACON_ENABLED=n
CONFIG_BT_MESH_LOW_POWER=y
CONFIG_BT_MESH_FRIEND=n

CONFIG_BT_MESH_PB_GATT=y
CONFIG_BT_MESH_PB_ADV=y
CONFIG_BT_MESH_GATT_PROXY=y

CONFIG_BT_MESH_LPN_SCAN_LATENCY=30
CONFIG_BT_MESH_LPN_RECV_DELAY=40
#CONFIG_BT_MESH_LPN_POLL_TIMEOUT=300

CONFIG_BT_MESH_SUBNET_COUNT=2
CONFIG_BT_MESH_APP_KEY_COUNT=2
CONFIG_BT_MESH_MODEL_GROUP_COUNT=2
CONFIG_BT_MESH_LABEL_COUNT=3

CONFIG_BT_DEBUG_LOG=y
CONFIG_BT_MESH_DEBUG=n
CONFIG_BT_MESH_DEBUG_PROVISIONER=n
CONFIG_BT_MESH_DEBUG_PROV=n
CONFIG_BT_MESH_DEBUG_PROV_DEVICE=n
```

## src/main.c
```c
/**
 * Copyright (c) 2015 - Decawave Ltd, Dublin, Ireland.
 * Copyright (c) 2022 - Sven Hoyer
 * 
 * This is an Simple Bluetooth Low Energy Example for the 
 * DWM1001-DEV Board Zephyr
 */

#include <stddef.h>
#include <string.h>
#include <errno.h>

#include <zephyr.h>
#include <zephyr/types.h>
#include <sys/printk.h>
#include <sys/byteorder.h>

#include <sit_mesh.h>
#include <sit_led.h>

#define APP_NAME "SIMPLE MESH EXAMPLE\n"

/* size of stack area used by each thread */
#define STACKSIZE 2048

void main(void) {
	printk(APP_NAME);
	printk("==================\n");
	k_sleep(K_SECONDS(2));
	sit_mesh_init();
	sit_led_init();

	while(1) {
		if (sit_mesh_is_provisioned()) {
			sit_toggle_led(3);
		} else {
			sit_toggle_led(0);
		}
		k_sleep(K_SECONDS(1));
	}
	 
}
```
