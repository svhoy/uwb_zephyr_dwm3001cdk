## CMakeLists.txt
```
# SPDX-License-Identifier: Apache-2.0

cmake_minimum_required(VERSION 3.13.1)
find_package(Zephyr REQUIRED HINTS $ENV{ZEPHYR_BASE})
project(sit_twr_initiator_example)

target_sources(app PRIVATE
  src/main.c
)
```

## prj.conf
```kconfig
# Incresed stack due to settings API usage
CONFIG_SYSTEM_WORKQUEUE_STACK_SIZE=2048

#UWB Tranceiver
CONFIG_DW1000=y
CONFIG_SPI=y
CONFIG_GPIO=y

#LED
CONFIG_SIT_LED=y
```

## src/main.c
```c
/* 
*	main.c - 
*	Application main entry point 
*/
#include <zephyr/types.h>
#include <stddef.h>
#include <string.h>
#include <errno.h>
#include <sys/printk.h>
#include <sys/byteorder.h>
#include <zephyr.h>

#include "drivers/sit_led/sit_led.h"

#define APP_NAME "SIMPLE TWR Responder EXAMPLE\n"

void main(void) {
	printk(APP_NAME);
	printk("==================\n");

	dwm_led_init();


	/* Implement notification. At the moment there is no suitable way
	 * of starting delayed work so we do it here
	 */
	while (1) {
		k_sleep(K_SECONDS(1));

	}
}
```
