## CMakeLists.txt
```
# SPDX-License-Identifier: Apache-2.0
cmake_minimum_required(VERSION 3.13.1)

set(BOARD_ROOT "${CMAKE_CURRENT_SOURCE_DIR}/..")
set(DTS_ROOT "${CMAKE_CURRENT_SOURCE_DIR}/..")
set(BOARD qorvo_dwm3001cdk)

find_package(Zephyr REQUIRED HINTS $ENV{ZEPHYR_BASE})
project(sports_indoor_tracking)

# the binary only library from Qorvo has problems with -Os or -O2
zephyr_library_compile_options(-O1)

target_sources(app PRIVATE
  src/main.c
)
```

## prj.conf
```kconfig
# Activate SIT Subsys
CONFIG_SIT=y
CONFIG_SIT_LED=y
CONFIG_SIT_DIAGNOSTIC=y
CONFIG_SIT_BLE=y
CONFIG_SIT_JSON=y

# Logging 
CONFIG_LOG=y
CONFIG_LOG_PRINTK=y
CONFIG_CBPRINTF_FP_SUPPORT=y

# newlib is used to include extended math.h funcions (e.g. fabs())
CONFIG_NEWLIB_LIBC=y

# HW INFO
CONFIG_HWINFO=y
CONFIG_I2C=y

#BLE 
CONFIG_BT=y
CONFIG_BT_GATT_NOTIFY_MULTIPLE=y
CONFIG_BT_PERIPHERAL=y
CONFIG_BT_SMP=y
CONFIG_BT_SIGNING=y
CONFIG_BT_DIS=n
CONFIG_BT_ATT_PREPARE_COUNT=64
CONFIG_BT_BAS=n
CONFIG_BT_PRIVACY=y
CONFIG_BT_DEVICE_APPEARANCE=833
CONFIG_BT_DEVICE_NAME_DYNAMIC=y
CONFIG_BT_DEVICE_NAME_MAX=65
# Vergrößert den MTU BUFFER auf 251 weil default ist nur 23bytes
CONFIG_BT_BUF_ACL_TX_SIZE=251
CONFIG_BT_CTLR_DATA_LENGTH_MAX=251
CONFIG_BT_BUF_ACL_RX_SIZE=251
CONFIG_BT_L2CAP_TX_MTU=247
CONFIG_BT_HCI_TX_STACK_SIZE=1024

CONFIG_HEAP_MEM_POOL_SIZE=4096
CONFIG_SYSTEM_WORKQUEUE_STACK_SIZE=4096
```

## overlay-debug.conf
```kconfig
CONFIG_DEBUG=y
CONFIG_DEBUG_THREAD_INFO=y
CONFIG_DEBUG_OPTIMIZATIONS=y
```

## src/main.c
```c
/**********************************************************************************
 * 
 *  Copyright (C) 2023  Sven Hoyer
 *
 *  This program is free software: you can redistribute it and/or modify
 *  it under the terms of the GNU General Public License as published by
 *  the Free Software Foundation, either version 3 of the License, or
 *  (at your option) any later version.

 *  This program is distributed in the hope that it will be useful,
 *  but WITHOUT ANY WARRANTY; without even the implied warranty of
 *  MERCHANTABILITY or FITNESS FOR A PARTICULAR PURPOSE.  See the
 *  GNU General Public License for more details.

 *  You should have received a copy of the GNU General Public License
 *  along with this program.  If not, see <https://www.gnu.org/licenses/>.
 * 
***********************************************************************************/

/** 
 * @file main.c
 * @author Sven Hoyer (svhoy)
 * @date 17.04.2023
 * @brief Main File for start and running the SIT System.
 *
 * The main of Sports Indoor Tracking System. This File Handles the subsys. 
 * Here main handle will start. 
 *  
 * @bug No known bugs.
 * @todo everything 
 */
#include "deca_device_api.h"

#include <sit/sit.h>
#include <sit/sit_device.h>
#include <sit/sit_config.h>
#include <sit_led/sit_led.h>

#include <sit_ble/ble_init.h>
#include <sit_ble/ble_device.h>

#include <stdio.h>
#include <string.h>

#define APP_NAME "Sports Indoor Tracking\n"

#include <zephyr/kernel.h>
#include <zephyr/logging/log.h>
LOG_MODULE_REGISTER(sit_main, LOG_LEVEL_INF);

void initialization() {
	uint8_t error = 0;

	sit_led_init();

	if (sit_ble_init()) {
		LOG_ERR("Bluetooth init failed");
	}
	// repeat configuration when failed
	do {
		error = sit_init();
	} while (error > 1);
	
	LOG_INF("Init Fertig ");
}

int main(int argc, char *argv[])  {
	printk(APP_NAME);
	printk("==================\n");
	init_device_id();

	initialization();
	sit_run_forever();
	return 0;
}
```

## src/main.cpp
```c
/**
 *
 * Copyright (c) 2022 - Sven Hoyer
 * 
 * Sports Indoor Tracking System Main
 * 
 */
#include <sit.h>
#include <sit_led.h>
#include <sit_json.h>

#include <ble_init.h>
#include <ble_device.h>

#define APP_NAME "SIMPLE JSON EXAMPLE\n"

#include <zephyr.h>
#include <logging/log.h>
LOG_MODULE_REGISTER(sit_main, LOG_LEVEL_INF);


void main(void) {
	printk(APP_NAME);
	printk("==================\n");

	sit_led_init();
	ble_init();
	
	while(42) { //Life, the universe, and everything

	}

}
```
